## examples/linux/distro/buildroot/package/kb-serial/Config.in
```kconfig
config BR2_PACKAGE_KB_SERIAL
	bool "kb-serial"
	help
	  Read a Linux serial port with a bounded wait and print bytes as hex.
```

## examples/linux/distro/meta-embedded-code-kb/conf/layer.conf
```bitbake
BBPATH .= ":${LAYERDIR}"
BBFILES += "${LAYERDIR}/recipes-*/*/*.bb"

BBFILE_COLLECTIONS += "embedded-code-kb"
BBFILE_PATTERN_embedded-code-kb = "^${LAYERDIR_RE}/"
BBFILE_PRIORITY_embedded-code-kb = "6"

LAYERDEPENDS_embedded-code-kb = "core"
LAYERSERIES_COMPAT_embedded-code-kb = "scarthgap"
```
